## arch/wasm/Kconfig
```kconfig
config WASM
	def_bool y
	select ARCH_HAS_SYSCALL_WRAPPER
	select ARCH_HAS_MEMBLOCK_MATERIALIZE
	select ARCH_WANTS_BUDDY_ALLOCATOR_BOTTOM_UP
	select ARCH_NO_PREEMPT
	select ARCH_NO_SWAP
	select BUG
	select FLATMEM
	select GENERIC_CPU_DEVICES
	select GENERIC_CSUM
	select GENERIC_ENTRY
	select GENERIC_HWEIGHT
	select GENERIC_IRQ_MIGRATION if SMP
	select GENERIC_IRQ_PROBE
	select GENERIC_IRQ_SHOW
	select GENERIC_SMP_IDLE_THREAD
	select HOTPLUG_PARALLEL if SMP
	select IRQ_DOMAIN
	select OF
	select OF_EARLY_FLATTREE
	select OF_IRQ
	select HAVE_PAGE_SIZE_4KB
	select HAVE_PAGE_SIZE_64KB
	select SMP if !WASM_JSPI
	select THREAD_INFO_IN_TASK

config WASM_JSPI
	bool "Run every task on one JavaScript event loop (JSPI)"
	help
	  One CPU, and every task a coroutine on the host's event loop: a task
	  blocks by suspending through JavaScript Promise Integration, not by
	  waiting on an atomic in a worker of its own. The kernel enters user
	  code through its own function table (call_indirect), so no
	  JavaScript frame is between a task's syscall and its suspension.

config EXOBOX
	bool "exobox's host interface"
	depends on WASM_JSPI
	help
	  What exobox's host (packages/exobox in its fork of tombl/distro)
	  adds, in arch/wasm/exobox/: fork (clone returning twice, the
	  program unwinding its stack with Asyncify).

config CMDLINE
	string "Kernel command string to append"
	default ""

config MMU
	def_bool n

config EARLY_PRINTK
	def_bool y

config SMP
	# (one CPU on one event loop: a uniprocessor kernel)
	def_bool !WASM_JSPI

config NR_CPUS
	int
	default 1 if !SMP
	default 64 if SMP

config HZ
	int
	default 100

config GENERIC_BUG
	bool

config GENERIC_HWEIGHT
	def_bool y

config GENERIC_CSUM
	def_bool y

config ARCH_DMA_ADDR_T_64BIT
	def_bool 64BIT

config PHYS_ADDR_T_64BIT
	def_bool 64BIT

config 64BIT
	bool "64bit kernel"
	default n

config HIGHMEM
	def_bool n
	select KMAP_LOCAL

config CONSOLE_LOGLEVEL_QUIET
	int "quiet console loglevel (1-15)"
	range 1 15
	default "4"

config LD_IS_WASMLD
	def_bool y

config DEFAULT_MEM_START
	hex
	prompt "PAGE_OFFSET/PHYS_OFFSET" if !MMU
	default 0x00000000
	help
	  This is the base address used for both PAGE_OFFSET and PHYS_OFFSET
	  in noMMU configurations.

	  If unsure, leave the default value here.

source "arch/wasm/drivers/Kconfig"
```

## arch/wasm/configs/exobox_defconfig
```kconfig
# CONFIG_LOCALVERSION_AUTO is not set
CONFIG_POSIX_MQUEUE=y
CONFIG_NO_HZ_IDLE=y
CONFIG_HIGH_RES_TIMERS=y
CONFIG_CGROUPS=y
CONFIG_BLK_DEV_INITRD=y
# CONFIG_RD_BZIP2 is not set
# CONFIG_RD_LZMA is not set
# CONFIG_RD_XZ is not set
# CONFIG_RD_LZO is not set
# CONFIG_RD_LZ4 is not set
# CONFIG_RD_ZSTD is not set
# CONFIG_INITRAMFS_PRESERVE_MTIME is not set
CONFIG_CC_OPTIMIZE_FOR_SIZE=y
CONFIG_EXPERT=y
# CONFIG_FHANDLE is not set
# CONFIG_AIO is not set
# CONFIG_IO_URING is not set
# CONFIG_MEMBARRIER is not set
CONFIG_KCMP=y
CONFIG_WASM_JSPI=y
CONFIG_EXOBOX=y
# CONFIG_COREDUMP is not set
# CONFIG_COMPAT_BRK is not set
# CONFIG_VM_EVENT_COUNTERS is not set
CONFIG_MEMFD_CREATE=y
CONFIG_NET=y
CONFIG_UNIX=y
CONFIG_INET=y
# CONFIG_IPV6 is not set
CONFIG_DEVTMPFS=y
CONFIG_DEVTMPFS_MOUNT=y
# CONFIG_STANDALONE is not set
# CONFIG_PREVENT_FIRMWARE_BUILD is not set
# CONFIG_FW_LOADER is not set
# CONFIG_ALLOW_DEV_COREDUMP is not set
CONFIG_NETDEVICES=y
CONFIG_NET_FAILOVER=y
# CONFIG_LEGACY_PTYS is not set
# CONFIG_DEVMEM is not set
# CONFIG_HWMON is not set
# CONFIG_USB_SUPPORT is not set
# CONFIG_VIRTIO_MENU is not set
# CONFIG_VHOST_MENU is not set
CONFIG_EXT2_FS=y
CONFIG_EXT4_FS=y
# CONFIG_DNOTIFY is not set
# CONFIG_INOTIFY_USER is not set
CONFIG_FUSE_FS=y
# CONFIG_FUSE_PASSTHROUGH is not set
CONFIG_OVERLAY_FS=y
CONFIG_SQUASHFS=y
CONFIG_EROFS_FS=y
# CONFIG_EROFS_FS_XATTR is not set
# CONFIG_EROFS_FS_BACKED_BY_FILE is not set
# CONFIG_EROFS_FS_ZIP is not set
# CONFIG_DEBUG_MISC is not set
CONFIG_MAGIC_SYSRQ=y
# CONFIG_SLUB_DEBUG is not set
CONFIG_PANIC_TIMEOUT=-1
# CONFIG_RUNTIME_TESTING_MENU is not set
```

## arch/wasm/drivers/Kconfig
```kconfig
config VIRTIO_WASM
	tristate "Platform bus driver for WebAssembly virtio devices"
	select VIRTIO
	help
	 This driver supports virtio devices on the WebAssembly platform.

config FB_WASM
	tristate
	depends on FB

config WASM_HOST_DEVICES
	bool "Console and disks as direct host calls"
	default WASM_JSPI
	select HVC_DRIVER
	select HVC_IRQ
	help
	  hvc0 and /dev/vd[a-z] backed by host imports (kernel.console_*,
	  kernel.blk_*), called synchronously: no virtqueues. A disk request
	  completes in the call that submits it.
```

## arch/wasm/exobox/Kconfig
```kconfig
# SPDX-License-Identifier: GPL-2.0-only
# exobox's host interface, part by part (arch/wasm/exobox/)

config EXOBOX
	bool "exobox's host interface"
	depends on WASM_JSPI
	help
	  What exobox's host (packages/exobox in its fork of tombl/distro)
	  adds, in arch/wasm/exobox/: fork (clone returning twice, the
	  program unwinding its stack with Asyncify), and a preemption point
	  at syscalls, where the host's event loop turns once a time slice;
	  and the parts below, each its own option.

config EXOBOX_HOSTFUSE
	bool "Host directories: filesystems the host serves with FUSE (hostfuse)"
	depends on EXOBOX && FUSE_FS=y
	help
	  mount -t hostfuse TAG DIR mounts the host's filesystem TAG: FUSE
	  requests go straight to the host as lists of their pieces, and its
	  replies come back the same way, without virtqueues (hostfuse.c).

config EXOBOX_HOSTSOCK
	bool "The guest's inet sockets made by the host"
	depends on EXOBOX && INET
	default y
	help
	  AF_INET and AF_INET6 stream and datagram sockets whose peer isn't
	  the guest itself are the host's (its network, its policy), through
	  kernel.sock_* imports; loopback ones stay the kernel's.
```
