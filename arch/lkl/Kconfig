## arch/lkl/Kconfig
```kconfig
config LKL
	def_bool y
	depends on !SMP && !COREDUMP && !SECCOMP && !UPROBES && !COMPAT && !USER_RETURN_NOTIFIER
	select ARCH_THREAD_STACK_ALLOCATOR
	select GENERIC_ATOMIC64
	select GENERIC_HWEIGHT
	select FLATMEM
	select GENERIC_CLOCKEVENTS
	select GENERIC_CPU_DEVICES
	select NO_HZ_IDLE
	select NO_PREEMPT
	select ARCH_WANT_FRAME_POINTERS
	select UACCESS_MEMCPY
	select GENERIC_STRNCPY_FROM_USER
	select GENERIC_STRNLEN_USER
	select HAVE_ARCH_KASAN

config LKL_TRACING
	bool "Tracing support"
	default y
	select TRACING
	help
	  Select TRACING, which KASAN's KUnit tests need for their console
	  tracepoints. TRACING has no prompt of its own, so without this
	  option it could not be turned off; without it an embedder saves
	  about 1 MiB of slab and 0.5 MiB of text.

config LKL_TSI
	bool "Impersonated AF_INET sockets, served by the host"
	default y
	depends on INET && UNIX
	help
	  A program's AF_INET stream and datagram sockets stay the guest's
	  own for loopback, and are served by the host for every other
	  address: connects, listens and datagrams go to the host
	  operations net_connect, net_listen and net_sendto, and the host
	  moves the bytes with lkl_net_* (asm/host_ops.h). Modelled on
	  libkrunfw's Transparent Socket Impersonation, with direct calls
	  instead of vsock. Without it, only loopback works.

config LKL_FUZZING
	bool "LLVM fuzzing instrumentation"
	default n
	help
	  This configuration option enables fuzzing instrumentation
	  for the Linux kernel source files to enable coverage-guided
	  fuzzing. At the moment LKL supports libFuzzer fuzzing
	  engine only.

config LKL_LINE_COV
	bool "Code coverage instrumentation for fuzzers"
	depends on LKL_FUZZING && CC_IS_CLANG
	default n
	help
	  This configuration option enables line code coverage
	  instrumentation for the Linux kernel to generate fuzzing
	  code coverage reports. When this option is enabled the
	  kernel source files are built with LLVM SanitizerCoverage
	  instrumentation.

config OUTPUT_FORMAT
	string "Output format"
	default $(shell,$(srctree)/arch/lkl/scripts/cc-objdump-file-format.sh)

config ARCH_DMA_ADDR_T_64BIT
	def_bool 64BIT

config PHYS_ADDR_T_64BIT
	def_bool 64BIT

config 64BIT
	bool "64bit kernel"
	default y if OUTPUT_FORMAT = "pe-x86-64"
	default $(success,$(srctree)/arch/lkl/scripts/cc-objdump-file-format.sh|grep -q '^elf64-') if OUTPUT_FORMAT != "pe-x86-64"

config MMU
	bool "LKL MMU implementation"
	depends on 64BIT
	default n

if MMU
config PGTABLE_LEVELS
	int
	default 3

config LKL_MEMORY_START
	hex
	default 0x50000000
	help
	  Base address of kernel virtual address space for LKL. No particular
	  reason for picking this specific value. It is assumed that the host
	  mmap is able to map requested amount of memory at this address.
	  STACK_TOP and VMALLOC_START values depend on it.

config LKL_TASK_UNMAPPED_BASE
	hex
	default 0x100000
	help
	  Starting virtual address for LKL user-space mmap. It is assumed that
	  the host mmap is able to map requested amount of memory starting from
	  this address.

config LKL_MMU_KUNIT_TEST
	bool "Kunit tests for LKL MMU"
	default n
	depends on KUNIT
	help
	  Kunit tests to test correctness of MMU-related kernel interfaces (such
	  as vmalloc, for example) which are difficult to test in user-space.
endif

config COREDUMP
	def_bool n

config CPU_BIG_ENDIAN
	bool "Big-endian kernel"
	default y if OUTPUT_FORMAT = "elf64-s390"
	default n if OUTPUT_FORMAT != "elf64-s390"

config GENERIC_CSUM
	def_bool y

config GENERIC_HWEIGHT
	def_bool y

config NO_IOPORT_MAP
	def_bool y

config HZ
	int "Timer frequency"
	range 100 1000
	default 100
	help
	  The tick rate. Boot waits for kernel threads in jiffies, so a
	  higher rate boots faster (about 45-75 ms at 100, 9-20 ms at
	  1000); with NO_HZ_IDLE an idle kernel takes no ticks either way.

config LKL_NR_IRQS
	int "Number of IRQs"
	range 64 4096 if 64BIT
	range 32 1024 if !64BIT
	default 4096 if 64BIT
	default 1024 if !64BIT
	help
	  Every IRQ's descriptor is allocated at boot (4096 of them take
	  about 2.4 MB of slab), so an embedder with a few devices can ask
	  for fewer. Must be a multiple of the bits in a long, and at most
	  their square: arch/lkl/kernel/irq.c keeps one word of pending
	  bits per long of IRQs, and one word summarising those.

config CONSOLE_LOGLEVEL_QUIET
	int "quiet console loglevel (1-15)"
	range 1 15
	default "4"
	help
	  loglevel to use when "quiet" is passed on the kernel commandline.

	  When "quiet" is passed on the kernel commandline this loglevel
	  will be used as the loglevel. IOW passing "quiet" will be the
	  equivalent of passing "loglevel=<CONSOLE_LOGLEVEL_QUIET>"

config PCI
	bool "PCI support"
	select NO_GENERIC_PCI_IOPORT_MAP
	select GENERIC_PCI_IOMAP
	select HAS_DMA
	select ARCH_HAS_DMA_OPS
	select PCI_MSI_ARCH_FALLBACKS if PCI_MSI
	default y

config LKL_PCI_KUNIT_TEST
	bool "KUnit tests for LKL PCI DMA"
	depends on PCI && KUNIT
	default n
	help
	  Enable KUnit tests for the LKL PCI DMA mapping operations.

	  These tests exercise the LKL PCI dma_map_ops allocation and free
	  paths through stub PCI host operations, and verify that coherent DMA
	  memory returned to callers is unmapped and released using the correct
	  CPU address.

config LKL_PCI_MSI_KUNIT_TEST
	bool "KUnit tests for LKL PCI MSI"
	depends on KUNIT && PCI_MSI
	default n
	help
	  KUnit tests for LKL's PCI MSI and MSI-X IRQ allocation hooks.

config RAID6_PQ_BENCHMARK
	bool
	default n

config STACKTRACE_SUPPORT
	def_bool y

if KASAN
config KASAN_SHADOW_OFFSET
	hex "KASAN shadow offset"
	default "0x0000200000000000" if OUTPUT_FORMAT = "elf64-x86-64"
	default "0" if OUTPUT_FORMAT != "elf64-x86-64"

config KASAN_SHADOW_SIZE
	hex "KASAN shadow size"
	default "0x0000100000000000" if OUTPUT_FORMAT = "elf64-x86-64"
	default "0" if OUTPUT_FORMAT != "elf64-x86-64"
endif

config BUILTIN_CMDLINE
	string "Built-in kernel command string"
	default ""
	help
	  Enter arguments here that should be compiled into the kernel
	  image and used at boot time. The command line provided to
	  lkl_start_kernel is appended to this string to form the full
	  command line.

config LKL_HOST_MEMCPY
	bool "Host provides memcpy"
	default $(success,$(srctree)/arch/lkl/scripts/cc-objdump-file-format.sh|grep -q '^elf64-') if 64BIT
	default $(success,$(srctree)/arch/lkl/scripts/cc-objdump-file-format.sh|grep -q '^elf32-') if !64BIT
	help
	  Set to "y" if LKL should call the host memcpy hook instead of
	  performing memory copies manually.

config LKL_HOST_MEMSET
	bool "Host provides memset"
	default LKL_HOST_MEMCPY
	help
	  Set to "y" if LKL should call the host memset hook instead of
	  performing memory sets manually.

config LKL_HOST_MEMMOVE
	bool "Host provides memmove"
	default LKL_HOST_MEMCPY
	help
	  Set to "y" if LKL should call the host memmove hook instead of
	  performing memory moves manually.
```
